## CMakeLists.txt
```
# SPDX-License-Identifier: Apache-2.0

cmake_minimum_required(VERSION 3.20.0)
find_package(Zephyr REQUIRED HINTS $ENV{ZEPHYR_BASE})
project(RTDB)

target_sources(app PRIVATE src/main.c src/rtdb.c src/UI.c)
```

## prj.conf
```kconfig
CONFIG_GPIO=y
CONFIG_SERIAL=y
CONFIG_CONSOLE=y
CONFIG_CBPRINTF_FP_SUPPORT=y
```

## app.overlay
```dts
/* nrf52840dk_nrf52840.overlay */
/ {
    zephyr,user {
        /* Opcional: Ajuda a organizar, mas o código C que te dei 
           usa macros diretas, por isso é meramente informativo aqui */
        io-channels = <&adc 1>; 
    };
};

/* OBRIGATÓRIO: Liga a "corrente" do bloco ADC dentro do chip */
&adc {
    status = "okay";
};
```

## src/main.c
```c
/* src/main.c */
#include <zephyr/kernel.h>
#include <zephyr/sys/printk.h>
#include "rtdb.h"
#include "ui.h"

/* --- CONFIGURAÇÃO DA THREAD DE UI --- */
#define UI_STACK_SIZE 1024
#define UI_PRIORITY 4 // Prioridade média-baixa (Display/LEDs)

/* Definir a memória (Stack) para a thread da UI */
K_THREAD_STACK_DEFINE(ui_stack_area, UI_STACK_SIZE);
struct k_thread ui_thread_data;


int main(void)
{
    printk("--- INICIO DO TESTE DE UI (LEDS + BOTOES) ---\n");

    /* 1. Inicializar a Base de Dados (RTDB) */
    /* Isto é obrigatório antes de qualquer outra coisa [cite: 76] */
    rtdb_init();

    /* TRUQUE DE TESTE: 
     * Como não temos sensor, fingimos que a sala está a 25.0 graus.
     * O Alvo inicial no rtdb.c também é 25.0.
     * Logo, ao ligar, deve acender o LED 2 (Normal).
     */
    rtdb_set_current_temp(25.0);

    /* 2. Inicializar o Hardware de Interface (GPIOs/Ints) */
    ui_init();

    /* 3. Arrancar a Thread que controla os LEDs */
    /* Esta thread vai correr em paralelo para sempre */
    k_thread_create(&ui_thread_data, ui_stack_area,
                    K_THREAD_STACK_SIZEOF(ui_stack_area),
                    (k_thread_entry_t)ui_led_thread_entry,
                    NULL, NULL, NULL,
                    UI_PRIORITY, 0, K_NO_WAIT);

    printk("Sistema pronto! Use os botoes para testar.\n");

    /* 4. Loop de Monitorização (Opcional, só para veres no PC) */
    while (1) {
        bool sistema_on = rtdb_get_system_on();
        double alvo = rtdb_get_target_temp();
        double atual = rtdb_get_current_temp(); // Vai ser sempre 25.0 neste teste

        /* Imprime estado a cada segundo para confirmares o que os LEDs mostram */
        printk("[MAIN] Sys: %s | Atual: %.1f | Alvo: %.1f | Diff: %.1f\n",
               sistema_on ? "ON " : "OFF",
               atual,
               alvo,
               atual - alvo);

        k_msleep(1000);
    }
    
    return 0;
}
```

## src/UI.c
```c
#include <zephyr/kernel.h>
#include <zephyr/drivers/gpio.h>
#include <zephyr/sys/printk.h>
#include "UI.h"
#include "rtdb.h"

//modelo de tempo real para o thread dos LEDs ( semaforos )
K_SEM_DEFINE(ui_sem, 0, 1);


// Definições dos botões (botões físicos do kit)
#define BTN0_NODE DT_ALIAS(sw0)
#define BTN1_NODE DT_ALIAS(sw1)
#define BTN3_NODE DT_ALIAS(sw3)

// Definições dos LEDs
#define LED0_NODE DT_ALIAS(led0)
#define LED1_NODE DT_ALIAS(led1)
#define LED2_NODE DT_ALIAS(led2)
#define LED3_NODE DT_ALIAS(led3)

// Estruturas dos GPIOs para botões e LEDs
static const struct gpio_dt_spec btn0 = GPIO_DT_SPEC_GET_OR(BTN0_NODE, gpios, {0});
static const struct gpio_dt_spec btn1 = GPIO_DT_SPEC_GET_OR(BTN1_NODE, gpios, {0});
static const struct gpio_dt_spec btn3 = GPIO_DT_SPEC_GET_OR(BTN3_NODE, gpios, {0});

static const struct gpio_dt_spec led0 = GPIO_DT_SPEC_GET_OR(LED0_NODE, gpios, {0});
static const struct gpio_dt_spec led1 = GPIO_DT_SPEC_GET_OR(LED1_NODE, gpios, {0});
static const struct gpio_dt_spec led2 = GPIO_DT_SPEC_GET_OR(LED2_NODE, gpios, {0});
static const struct gpio_dt_spec led3 = GPIO_DT_SPEC_GET_OR(LED3_NODE, gpios, {0});

// Callbacks dos botões ( interrupções )
static struct gpio_callback btn0_cb_data;
static struct gpio_callback btn1_cb_data;
static struct gpio_callback btn3_cb_data;

// Timer para acordar o thread dos LEDs periodicamente
void ui_timer_handler(struct k_timer *dummy)
{
    k_sem_give(&ui_sem);
}

K_TIMER_DEFINE(ui_timer, ui_timer_handler, NULL);

// BOTÃO INTERRUPTIONS HANDLERS

void button0_pressed(const struct device *dev, struct gpio_callback *cb, uint32_t pins)
{
    // Botão 0: ON/OFF
    rtdb_toggle_system_on();
}
void button1_pressed(const struct device *dev, struct gpio_callback *cb, uint32_t pins)
{
    // Botão 1: Aumentar temperatura alvo
    if(!rtdb_get_system_on()){
        // Se o sistema estiver OFF, não faz nada
        return;
    }
    rtdb_increment_target_temp();
}
void button3_pressed(const struct device *dev, struct gpio_callback *cb, uint32_t pins)
{
    // Botão 3: Diminuir temperatura alvo~
    if(!rtdb_get_system_on()){
        // Se o sistema estiver OFF, não faz nada
        return;
    }
    rtdb_decrement_target_temp();
}

// Funções de inicialização e thread dos LEDs

void ui_init(void)
{
    
    if (!gpio_is_ready_dt(&btn0) || !gpio_is_ready_dt(&btn1) || !gpio_is_ready_dt(&btn3) ||
        !gpio_is_ready_dt(&led0) || !gpio_is_ready_dt(&led1) || !gpio_is_ready_dt(&led2) || !gpio_is_ready_dt(&led3)) {
        printk("Erro: GPIO device not ready.\n");
        return;
    }

    gpio_pin_configure_dt(&led0, GPIO_OUTPUT_INACTIVE);
    gpio_pin_configure_dt(&led1, GPIO_OUTPUT_INACTIVE); 
    gpio_pin_configure_dt(&led2, GPIO_OUTPUT_INACTIVE);
    gpio_pin_configure_dt(&led3, GPIO_OUTPUT_INACTIVE);


    // -----------------------------------------------------------------------
    // Botao 1    
    if(gpio_pin_configure_dt(&btn0, GPIO_INPUT | GPIO_PULL_UP) < 0) {
        printk("Erro: Configuração do Botão 0 falhou.\n");
        return;
    }
    gpio_pin_interrupt_configure_dt(&btn0, GPIO_INT_EDGE_TO_ACTIVE);
    gpio_init_callback(&btn0_cb_data, button0_pressed, BIT(btn0.pin));
    gpio_add_callback(btn0.port, &btn0_cb_data);
    
    // -----------------------------------------------------------------------
    // Botao 2
    if(gpio_pin_configure_dt(&btn1, GPIO_INPUT | GPIO_PULL_UP) < 0) {
        printk("Erro: Configuração do Botão 1 falhou.\n");
        return;
    }
    gpio_pin_interrupt_configure_dt(&btn1, GPIO_INT_EDGE_TO_ACTIVE);
    gpio_init_callback(&btn1_cb_data, button1_pressed, BIT(btn1.pin));
    gpio_add_callback(btn1.port, &btn1_cb_data);

    // -----------------------------------------------------------------------
    // Botao 4
    if(gpio_pin_configure_dt(&btn3, GPIO_INPUT | GPIO_PULL_UP) < 0) {
    printk("Erro: Configuração do Botão 3 falhou.\n");
    return;
    }
    gpio_pin_interrupt_configure_dt(&btn3, GPIO_INT_EDGE_TO_ACTIVE);
    gpio_init_callback(&btn3_cb_data, button3_pressed, BIT(btn3.pin));
    gpio_add_callback(btn3.port, &btn3_cb_data);

}

// tAREFA periodica para atualizar os LEDs baseado o estado do sistema
void ui_led_thread_entry(void *p1, void *p2, void *p3)
{
   k_timer_start(&ui_timer, K_MSEC(100), K_MSEC(100)); // 100ms period

   while (1)
   {
    k_sem_take(&ui_sem, K_FOREVER);
    // printk("UI Thread woke up to update LEDs.\n");

    // Ler valores da RTDB
    double target_temp = rtdb_get_target_temp();
    double current_temp = rtdb_get_current_temp();
    double temp_diff = current_temp - target_temp;
    bool system_on = rtdb_get_system_on();

    // Saída nos Leds
    // Led 1
    gpio_pin_set_dt(&led0, system_on ? 1 : 0);
    if(!system_on) {
        // Sistema desligado, apagar todos os LEDs
        gpio_pin_set_dt(&led1, 0);
        gpio_pin_set_dt(&led2, 0);
        gpio_pin_set_dt(&led3, 0);
        continue;
    }
    else {
        // Sistema ligado, atualizar LEDs com base na diferença de temperatura
        if (temp_diff < -5.0) {
            // Muito frio
            gpio_pin_set_dt(&led1, 0);
            gpio_pin_set_dt(&led2, 1);
            gpio_pin_set_dt(&led3, 0);
        } else if (temp_diff > 5.0) {
            // Muito quente
            gpio_pin_set_dt(&led1, 0);
            gpio_pin_set_dt(&led2, 0);
            gpio_pin_set_dt(&led3, 1);
        } else {
            // Normal
            gpio_pin_set_dt(&led1, 1);
            gpio_pin_set_dt(&led2, 0);
            gpio_pin_set_dt(&led3, 0);
        }
    }
   }  
}
```

## src/UI.h
```c
#ifndef UI_H
#define UI_H

void ui_init(void);

void ui_led_thread_entry(void *p1, void *p2, void *p3);

#endif
```

## src/rtdb.c
```c
#include "rtdb.h"

// Variáveis privadas do RTDB
static bool system_on = false;
static double current_temp = 22.0;
static double target_temp = 25.0;

// Criação de mutex para proteção das variáveis por método estático
// Havia também a forma de criação dinêmica onde é declarado e depois inicializado.
K_MUTEX_DEFINE(rtdb_mutex);

void rtdb_init(void)
{
    // Inicialização DO mutex (já feito pela macro K_MUTEX_DEFINE) com memória reservada estaticamente 
}

void rtdb_set_system_on(bool on)        // Função para ligar ou desligar o sistema com base na bool on
{
    k_mutex_lock(&rtdb_mutex, K_FOREVER);
    system_on = on;
    k_mutex_unlock(&rtdb_mutex);
}

void rtdb_toggle_system_on(void)        // Função para alternar o estado do sistema (toggle)
{
    k_mutex_lock(&rtdb_mutex, K_FOREVER);
    system_on = !system_on;
    k_mutex_unlock(&rtdb_mutex);
}
void rtdb_increment_target_temp(void)   // Função para incrementar a temperatura alvo em 1 grau
{
    k_mutex_lock(&rtdb_mutex, K_FOREVER);
    target_temp += 1.0;
    k_mutex_unlock(&rtdb_mutex);
}
void rtdb_decrement_target_temp(void)   // Função para decrementar a temperatura alvo em 1 grau
{
    k_mutex_lock(&rtdb_mutex, K_FOREVER);
    target_temp -= 1.0;
    k_mutex_unlock(&rtdb_mutex);
}
void rtdb_set_current_temp(double temp) // Função para atualizar a temperatura atual
{
    k_mutex_lock(&rtdb_mutex, K_FOREVER);
    current_temp = temp;
    k_mutex_unlock(&rtdb_mutex);
}
// Funções GET seguras

bool rtdb_get_system_on(void)       // Função para obter o estado atual do sistema (ligado/desligado)
{
    bool on;
    k_mutex_lock(&rtdb_mutex, K_FOREVER);
    on = system_on;
    k_mutex_unlock(&rtdb_mutex);
    return on;
}
double rtdb_get_target_temp(void)   // Função para obter a temperatura alvo atual
{
    double temp;
    k_mutex_lock(&rtdb_mutex, K_FOREVER);
    temp = target_temp;
    k_mutex_unlock(&rtdb_mutex);
    return temp;
}
double rtdb_get_current_temp(void)  // Função para obter a temperatura atual
{
    double temp;
    k_mutex_lock(&rtdb_mutex, K_FOREVER);
    temp = current_temp;
    k_mutex_unlock(&rtdb_mutex);
    return temp;
}
```

## src/rtdb.h
```c
#ifndef RTDB_H
#define RTDB_H

#include <zephyr/kernel.h>

void rtdb_init(void);
void rtdb_set_system_on(bool on);
void rtdb_toggle_system_on(void);
void rtdb_increment_target_temp(void);
void rtdb_decrement_target_temp(void);
void rtdb_set_current_temp(double temp);


// Leituras seguras sem intereferência das variáveis globais
bool rtdb_get_system_on(void);
double rtdb_get_target_temp(void);
double rtdb_get_current_temp(void);

#endif
```

## src/temp_sensor.c
```c
#include <zephyr/kernel.h>
#include <zephyr/sys/printk.h>~
#include "temp_sensor.h"
#include <zephyr/drivers/adc.h>
#include <zephyr/logging/log.h>

LOG_MODULE_REGISTER(temp_sensor, LOG_LEVEL_INF); // Prints para Logging da UART

// configurações do ADC
// 1 - Nó do ADC no Device Tree
#define ADC_NODE  DT_INST(0 , nordic_nrf_saadc)

// 2 - Parametros do sensor de temperatura MCP9700 GND-VOUT-VDD
// VOUT = 500mV + (10mV/°C * T)
#define SENSOR_OFFSET_MV 500   // Offset em mV
#define SENSOR_MV_PER_DEGREE 10 // mV por grau Celsius

//  3 - Configuração do canal ADC
#define ADC_CHANNEL_ID 1
#define ADC_INPUT_PIN  ADC_INPUT_POSITIVE_ANALOG_IN1 // Pino AIN1

// 4 - Resolução do ADC
#define ADC_RESOLUTION 12 // 12 bits
// Levando em consideração que a tensão varia de 0.5V a 1.5V 
// E que a referência interna é 0.6V (600mV), precisamos ajustar a escala
// para mapear corretamente a faixa de tensão do sensor, com um ganho de 1/6
#define ADC_GAIN ADC_GAIN_1_6
#define ADC_REFERENCE ADC_REF_INTERNAL
#define ADC_ACQUISITION_TIME ADC_ACQ_TIME_DEFAULT

// Variaveis estaticas do driver ADC
static const struct device *adc_dev = DEVICE_DT_GET(ADC_NODE); // Busca o device ADC
static int16_t sample_buffer[5];                     // Buffer para apenas um amostra


//função de inicialização do ADC
void temp_sensor_init(void){
    if (!device_is_ready(adc_dev)){
        LOG_ERR("O ADC não está disponível ")
        return;
    }

    //configurações do canal ADC
    channel_cfg.channel_id = ADC_CHANNEL_ID;
    channel_cfg
}
```

## src/temp_sensor.h
```c
#ifndef TEMP_SENSOR_H
#define TEMP_SENSOR_H

void temp_sensor_init(void);

double temp_sensor_init(void);
int temp_sensor_read_filter(double *temp_out);

#endif // TEMP_SENSOR_H
```
